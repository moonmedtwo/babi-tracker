## CMakeLists.txt
```
#
# Copyright (c) 2020 Nordic Semiconductor
#
# SPDX-License-Identifier: LicenseRef-Nordic-5-Clause
#

cmake_minimum_required(VERSION 3.20.0)

find_package(Zephyr REQUIRED HINTS $ENV{ZEPHYR_BASE})
project(https_client)

# NORDIC SDK APP START
target_sources(app PRIVATE src/main.c 
            src/gnss_app.c 
            src/assistance_minimal.c
            src/mcc_location_table.c)
# NORDIC SDK APP END
```

## Kconfig
```
#
# Copyright (c) 2021 Nordic Semiconductor ASA
#
# SPDX-License-Identifier: LicenseRef-Nordic-5-Clause
#

menu "HTTPS client sample"

config SAMPLE_TFM_MBEDTLS
	bool "Use TF-M and MbedTLS"
	help
	  Use TF-M and MbedTLS in this sample instead of using
	  the offloaded TLS stack in the modem.

endmenu

choice
	default GNSS_SAMPLE_ASSISTANCE_NONE
	prompt "Select whether GNSS assistance is used or not"

config GNSS_SAMPLE_ASSISTANCE_NONE
	bool "Assistance not used"

config GNSS_SAMPLE_ASSISTANCE_NRF_CLOUD
	bool "Use nRF Cloud A-GPS or P-GPS"
	select NRF_CLOUD_REST
	imply NRF_CLOUD_AGPS
	select MODEM_JWT
	select MODEM_INFO
	select DATE_TIME

config GNSS_SAMPLE_ASSISTANCE_SUPL
	bool "Use SUPL A-GPS"
	select SUPL_CLIENT_LIB

config GNSS_SAMPLE_ASSISTANCE_MINIMAL
	bool "Use factory almanac, LTE network time and MCC based location"
	select GNSS_SAMPLE_LTE_ON_DEMAND
	select SETTINGS
	select FCB
	select FLASH
	select FLASH_MAP

endchoice

menu "Zephyr Kernel"
source "Kconfig.zephyr"
endmenu
```

## prj.conf
```kconfig
CONFIG_MODEM_KEY_MGMT=y

CONFIG_REST_CLIENT=y

# General
CONFIG_FPU=y
CONFIG_NRF_MODEM_LIB=y
CONFIG_STDOUT_CONSOLE=y
CONFIG_UART_INTERRUPT_DRIVEN=y
CONFIG_NEWLIB_LIBC=y
CONFIG_NEWLIB_LIBC_FLOAT_PRINTF=y
CONFIG_LOG=y
CONFIG_LOG_MODE_IMMEDIATE=y

# LTE Link Control
CONFIG_LTE_LINK_CONTROL=y
CONFIG_LTE_AUTO_INIT_AND_CONNECT=n
CONFIG_LTE_NETWORK_MODE_LTE_M_NBIOT_GPS=y
CONFIG_PDN=y
CONFIG_PDN_DEFAULTS_OVERRIDE=y
CONFIG_PDN_DEFAULT_APN="hologram"
CONFIG_PDN_DEFAULT_FAM_IPV4=y

# Request eDRX from the network
CONFIG_LTE_EDRX_REQ=y
# PSM requested periodic TAU 8 hours
CONFIG_LTE_PSM_REQ_RPTAU="00101000"
# PSM requested active time 6 seconds
CONFIG_LTE_PSM_REQ_RAT="00000011"

# AT Host library - Used to send AT commands directy from an UART terminal and to allow
#		    integration with nRF Connect for Desktop LTE Link monitor application.
CONFIG_AT_HOST_LIBRARY=y

# Networking
CONFIG_NETWORKING=y
CONFIG_NET_SOCKETS_OFFLOAD=y
CONFIG_NET_SOCKETS=y
CONFIG_NET_SOCKETS_POSIX_NAMES=y
# Disable native network stack to save some memory
CONFIG_NET_NATIVE=n

# Memory and stack configuration
CONFIG_HEAP_MEM_POOL_SIZE=2048
CONFIG_MAIN_STACK_SIZE=4096
CONFIG_SYSTEM_WORKQUEUE_STACK_SIZE=1536

CONFIG_GNSS_SAMPLE_ASSISTANCE_MINIMAL=y
CONFIG_CJSON_LIB=y
CONFIG_BOOTLOADER_MCUBOOT=y
```

## src/main.c
```c
/*
 * Copyright (c) 2020 Nordic Semiconductor ASA
 *
 * SPDX-License-Identifier: LicenseRef-Nordic-5-Clause
 */

#include <string.h>
#include <zephyr/kernel.h>
#include <stdlib.h>
#include <zephyr/net/socket.h>
#include <modem/nrf_modem_lib.h>
#include <zephyr/net/tls_credentials.h>
#include <modem/lte_lc.h>
#include <modem/modem_key_mgmt.h>
#include <net/rest_client.h>
#include "commit_hash.h"
#include <cJSON.h>

LOG_MODULE_REGISTER(App, 3);

#define ENDPOINT_BATTERY "/api/v1/devices/battery"
#define ENDPOINT_LOCATION "/api/v1/devices/location"

#define HTTPS_PORT 443

#define HTTPS_HOSTNAME "consumer-dev.itspersonalservices.com"

#define RECV_BUF_SIZE 2048
#define TLS_SEC_TAG 42

static char recv_buf[RECV_BUF_SIZE];
static char DEV_UUID[40];
static char MODEM_FW_VER[50];

/* Certificate for `example.com` */
static const char cert[] = {
    #include "../cert/DigiCertGlobalRootCA.pem"
};

BUILD_ASSERT(sizeof(cert) < KB(4), "Certificate too large");

/* Provision certificate to modem */
int cert_provision(void)
{
    int err;
    bool exists;
    int mismatch;

    /* It may be sufficient for you application to check whether the correct
     * certificate is provisioned with a given tag directly using modem_key_mgmt_cmp().
     * Here, for the sake of the completeness, we check that a certificate exists
     * before comparing it with what we expect it to be.
     */
    err = modem_key_mgmt_exists(TLS_SEC_TAG, MODEM_KEY_MGMT_CRED_TYPE_CA_CHAIN, &exists);
    if (err) {
        printk("Failed to check for certificates err %d\n", err);
        return err;
    }

    if (exists) {
        mismatch = modem_key_mgmt_cmp(TLS_SEC_TAG,
                          MODEM_KEY_MGMT_CRED_TYPE_CA_CHAIN,
                          cert, strlen(cert));
        if (!mismatch) {
            printk("Certificate match\n");
            return 0;
        }

        printk("Certificate mismatch\n");
        err = modem_key_mgmt_delete(TLS_SEC_TAG, MODEM_KEY_MGMT_CRED_TYPE_CA_CHAIN);
        if (err) {
            printk("Failed to delete existing certificate, err %d\n", err);
        }
    }

    printk("Provisioning certificate\n");

    /*  Provision certificate to the modem */
    err = modem_key_mgmt_write(TLS_SEC_TAG,
                   MODEM_KEY_MGMT_CRED_TYPE_CA_CHAIN,
                   cert, sizeof(cert) - 1);
    if (err) {
        printk("Failed to provision certificate, err %d\n", err);
        return err;
    }

    return 0;
}

/* Setup TLS options on a given socket */
int tls_setup(int fd)
{
    int err;
    int verify;

    /* Security tag that we have provisioned the certificate with */
    const sec_tag_t tls_sec_tag[] = {
        TLS_SEC_TAG,
    };

#if defined(CONFIG_SAMPLE_TFM_MBEDTLS)
    err = tls_credential_add(tls_sec_tag[0], TLS_CREDENTIAL_CA_CERTIFICATE, cert, sizeof(cert));
    if (err) {
        return err;
    }
#endif

    /* Set up TLS peer verification */
    enum {
        NONE = 0,
        OPTIONAL = 1,
        REQUIRED = 2,
    };

    verify = NONE;

    err = setsockopt(fd, SOL_TLS, TLS_PEER_VERIFY, &verify, sizeof(verify));
    if (err) {
        printk("Failed to setup peer verification, err %d\n", errno);
        return err;
    }

    /* Associate the socket with the security tag
     * we have provisioned the certificate with.
     */
    err = setsockopt(fd, SOL_TLS, TLS_SEC_TAG_LIST, tls_sec_tag,
             sizeof(tls_sec_tag));
    if (err) {
        printk("Failed to setup TLS sec tag, err %d\n", errno);
        return err;
    }

    err = setsockopt(fd, SOL_TLS, TLS_HOSTNAME, HTTPS_HOSTNAME, sizeof(HTTPS_HOSTNAME) - 1);
    if (err) {
        printk("Failed to setup TLS hostname, err %d\n", errno);
        return err;
    }
    return 0;
}

K_SEM_DEFINE(lte_ready, 0, 1);

volatile bool lte_connected = false;

static void lte_lc_event_handler(const struct lte_lc_evt *const evt)
{
	switch (evt->type) {
	case LTE_LC_EVT_NW_REG_STATUS:
		if ((evt->nw_reg_status == LTE_LC_NW_REG_REGISTERED_HOME) ||
		    (evt->nw_reg_status == LTE_LC_NW_REG_REGISTERED_ROAMING)) {
			LOG_INF("Connected to LTE network");
            lte_connected = true;
			k_sem_give(&lte_ready);
		}
		break;

	default:
		break;
	}
}

void lte_connect(void)
{
    if (lte_connected == true)
    {
        return;
    }

	int err;

	LOG_INF("Connecting to LTE network");

	err = lte_lc_func_mode_set(LTE_LC_FUNC_MODE_ACTIVATE_LTE);
	if (err) {
		LOG_ERR("Failed to activate LTE, error: %d", err);
		return;
	}

	if(k_sem_take(&lte_ready, K_SECONDS(10)) != 0)
    {
        LOG_ERR("Connecting timeout");
    }
    else
    {
	    /* Wait for a while, because with IPv4v6 PDN the IPv6 activation takes a bit more time. */
	    k_sleep(K_SECONDS(1));
    }
}

void lte_disconnect(void)
{
	int err;

	err = lte_lc_func_mode_set(LTE_LC_FUNC_MODE_DEACTIVATE_LTE);
	if (err) {
		LOG_ERR("Failed to deactivate LTE, error: %d", err);
		return;
	}

    lte_connected = false;
	LOG_INF("LTE disconnected");
}

extern volatile double last_latitude;
extern volatile double last_longtitude;

static uint8_t msg_buffer[128];

K_THREAD_STACK_DEFINE(stack_gnss, 4096);
struct k_thread thread_data_gnss;
#define THREAD_PRIORITY_GNSS 5

extern void entrypoint_gnss(void *arg1, void *arg2, void *arg3);

void create_gnss_thread()
{
    k_tid_t tid_mqtt = k_thread_create(&thread_data_gnss, stack_gnss,
                                 K_THREAD_STACK_SIZEOF(stack_gnss),
                                 entrypoint_gnss,
                                 NULL, NULL, NULL,
                                 THREAD_PRIORITY_GNSS, 0, K_NO_WAIT);
}

void app_main_handler(int socket)
{
    struct rest_client_req_context req_ctx = {
        /** Socket identifier for the connection. When using the default value,
         *  the library will open a new socket connection. Default: REST_CLIENT_SCKT_CONNECT.
         */
        .connect_socket = socket,
        /** Defines whether the connection should remain after API call. Default: false. */
        .keep_alive = true,
        /** Security tag. Default: REST_CLIENT_SEC_TAG_NO_SEC. */
        .sec_tag = TLS_SEC_TAG,
        /** Indicates the preference for peer verification.
         *  Initialize to REST_CLIENT_TLS_DEFAULT_PEER_VERIFY
         *  and the default (TLS_PEER_VERIFY_REQUIRED) is used.
         */
        .tls_peer_verify = 0, // No build verification
        /** Used HTTP method. */
        .http_method = HTTP_PUT,
        /** Hostname or IP address to be used in the request. */
        .host = HTTPS_HOSTNAME,
        /** Port number to be used in the request. */
        .port = HTTPS_PORT,
        /** The URL for this request, for example: /index.html */
        .url = "/api/v1/devices/battery",
        /** The HTTP header fields. Similar to the Zephyr HTTP client.
         *  This is a NULL-terminated list of header fields. May be NULL.
         */
        .header_fields = NULL,
        /** Payload/body, may be NULL. */
        .body = msg_buffer,
        /** User-defined timeout value for REST request. The timeout is set individually
         *  for socket connection creation and data transfer meaning REST request can take
         *  longer than this given timeout. To disable, set the timeout duration to SYS_FOREVER_MS.
         *  A value of zero will result in an immediate timeout.
         *  Default: CONFIG_REST_CLIENT_REST_REQUEST_TIMEOUT.
         */
        .timeout_ms = 30000,
        /** User-allocated buffer for receiving API response. */
        .resp_buff = recv_buf,
        /** User-defined size of resp_buff. */
        .resp_buff_len = RECV_BUF_SIZE,
    };
    struct rest_client_resp_context resp_ctx;
    memset(&resp_ctx, 0, sizeof(resp_ctx));

    const int polling_interval = 60;
    while (1)
    {
        LOG_INF("Do scheduled job ...");

        cJSON* sensorDataObj = cJSON_CreateObject(); cJSON_AddItemToObject(sensorDataObj, "uuid", cJSON_CreateString(DEV_UUID));
        cJSON_AddItemToObject(sensorDataObj, "bat", cJSON_CreateNumber(1.0));
        cJSON_PrintPreallocated(sensorDataObj, msg_buffer, sizeof(msg_buffer), false);
        int err = -1;
        req_ctx.url = ENDPOINT_BATTERY;
        err = rest_client_request(&req_ctx, &resp_ctx);
        if(err == 0)
        {
            LOG_INF("Put msg [%s] to endpoint \"%s\" succeeded", msg_buffer, req_ctx.url);
        }
        else
        {
            LOG_ERR("Put msg [%s] to endpoint \"%s\" failed with err %d", msg_buffer, req_ctx.url, err);
            if(resp_ctx.response != NULL)
            {
                LOG_INF("Response: %s", resp_ctx.response);
            }
        }

        memset(&resp_ctx, 0, sizeof(resp_ctx));

        cJSON_DetachItemFromObject(sensorDataObj, "bat");
        cJSON_AddItemToObject(sensorDataObj, "lat", cJSON_CreateNumber(last_latitude));
        cJSON_AddItemToObject(sensorDataObj, "long", cJSON_CreateNumber(last_longtitude));
        cJSON_PrintPreallocated(sensorDataObj, msg_buffer, sizeof(msg_buffer), false);
        req_ctx.url = ENDPOINT_LOCATION;
        err = rest_client_request(&req_ctx, &resp_ctx);
        if(err == 0)
        {
            LOG_INF("Put msg [%s] to endpoint \"%s\" succeeded", msg_buffer, req_ctx.url);
        }
        else
        {
            LOG_ERR("Put msg [%s] to endpoint \"%s\" failed with err %d", msg_buffer, req_ctx.url, err);
            if(resp_ctx.response != NULL)
            {
                LOG_INF("Response: %s", resp_ctx.response);
            }
        }
        cJSON_Delete(sensorDataObj);
        k_sleep(K_SECONDS(polling_interval));
    }
}

void main(void)
{
    int err;
    int fd;
    char *p;
    int bytes;
    size_t off;

    struct addrinfo hints = {
        .ai_family = AF_INET,
        .ai_socktype = SOCK_STREAM,
    };

    LOG_INF("Its Personal Build %s", HASH);
    LOG_INF("Using APN: %s", CONFIG_PDN_DEFAULT_APN);
    int ret_scanf = nrf_modem_at_scanf("AT+CGMR", "%s", &MODEM_FW_VER);
    if (ret_scanf != 1)
    {
        LOG_ERR("Failed to read modem firmware version");
        return -1;
    }
    LOG_INF("Modem firmware %s", &MODEM_FW_VER);

#if !defined(CONFIG_SAMPLE_TFM_MBEDTLS)
    /* Provision certificates before connecting to the LTE network */
    err = cert_provision();
    if (err) {
        return;
    }
#endif

    LOG_INF("Waiting for network...");
    if (IS_ENABLED(CONFIG_LTE_AUTO_INIT_AND_CONNECT))
    {
        LOG_INF("Enabled CONFIG_PDN_DEFAULT_APN");
        nrf_modem_at_printf("AT+COPS=1,2\"45202\"");
    }
    else
    {
        if (lte_lc_init() != 0) {
            LOG_ERR("Failed to initialize LTE link controller");
            return -1;
        }

        lte_lc_register_handler(lte_lc_event_handler);
        lte_lc_psm_req(true);
    }

    ret_scanf = nrf_modem_at_scanf("AT%XMODEMUUID", "%%XMODEMUUID: %s", &DEV_UUID);
    if (ret_scanf != 1)
    {
        LOG_ERR("Failed to read device uuid");
        return -1;
    }
    LOG_INF("Device uuid: %s", DEV_UUID);

    create_gnss_thread();

    while ((fabs(last_latitude - 0) < 0.5) 
        && (fabs(last_longtitude - 0) < 0.5))
    {
        LOG_INF("Waiting for first GPS fix ...");
        k_sleep(K_SECONDS(10));
    }

    lte_connect();

    struct dns_server_lookup {
        uint32_t addr;
        uint8_t addr_u8[4];
    };

    struct dns_server_lookup dns_servers[] =
    {
        // Google DNS primary
        {
            .addr = 134744072,
            .addr_u8 = {8,8,8,8}
        },
        // Google DNS secondary
        {
            .addr = 134743044,
            .addr_u8 = {8,8,4,4}
        },
        // OpenDNS primary
        {
            .addr = 3494108894,
            .addr_u8 = {208,67,222,222}
        },
        // OpenDNS secondary
        {
            .addr = 3494108894,
            .addr_u8 = {208,67,222,222}
        },
        {
            .addr = 0,
            .addr_u8 = {0,0,0,}
        }
    };

    err = -1;
    int dns_idx = 0;

    struct addrinfo *res = 0;
    while (err != 0 && dns_servers[dns_idx].addr != 0)
    {
        uint8_t * p_ipu8 = dns_servers[dns_idx].addr_u8;
        LOG_INF("Resolving %s using DNS server %d.%d.%d.%d", HTTPS_HOSTNAME, p_ipu8[0],  p_ipu8[1],  p_ipu8[2],  p_ipu8[3]);
        /* Setting google dns to resolve the hostname */
        struct nrf_in_addr dns;
        // dns.s_addr = 134744072; // Google DNS primary, 8.8.8.8
        // dns.s_addr = 134743044; // Google DNS secondary, 8.8.4.4
        dns.s_addr = dns_servers[dns_idx].addr; // OpenDNS, 208.67.222.222
        int dns_err = nrf_setdnsaddr(NRF_AF_INET, &dns, sizeof(dns));
        LOG_INF("DNS set result %d", dns_err);

        err = getaddrinfo(HTTPS_HOSTNAME, NULL, &hints, &res);
        if (err == 0) {
            break;
        }
            
        LOG_INF("DNS server %d.%d.%d.%d failed with err %d", p_ipu8[0],  p_ipu8[1],  p_ipu8[2],  p_ipu8[3], err);
        freeaddrinfo(res);
        dns_idx++;
    }

    if (err) {
        LOG_ERR("Resolving %s failed with all DNS servers\n",HTTPS_HOSTNAME);
        return;
    }

    ((struct sockaddr_in *)res->ai_addr)->sin_port = htons(HTTPS_PORT);
    
    /* Try to open the socket with tls protocol enabled */
    if (IS_ENABLED(CONFIG_SAMPLE_TFM_MBEDTLS)) {
        fd = socket(AF_INET, SOCK_STREAM | SOCK_NATIVE_TLS, IPPROTO_TLS_1_2);
    } else {
        fd = socket(AF_INET, SOCK_STREAM, IPPROTO_TLS_1_2);
    }
    if (fd == -1) {
        LOG_ERR("Failed to open socket!");
        goto clean_up;
    }

    /* Setup TLS socket options */
    err = tls_setup(fd);
    if (err) {
        goto clean_up;
    }

    /* Connecting to the host with provided socket */
    LOG_INF("Connecting to %s", HTTPS_HOSTNAME);
    err = connect(fd, res->ai_addr, sizeof(struct sockaddr_in));
    if (err) {
        LOG_ERR("connect() failed, err: %d", errno);
        goto clean_up;
    }
    LOG_INF("Connected");

    app_main_handler(fd);

clean_up:
    LOG_INF("Finished, closing socket.");
    if (res != 0)
    {
        freeaddrinfo(res);
    }
    (void)close(fd);

    lte_lc_power_off();
    LOG_INF("Cleaned up, shutting down ...");
}
```

## src/assistance_minimal.c
```c
/*
 * Copyright (c) 2021 Nordic Semiconductor ASA
 *
 * SPDX-License-Identifier: LicenseRef-Nordic-5-Clause
 */

#include <stdio.h>
#include <stdlib.h>
#include <zephyr/kernel.h>
#include <zephyr/sys/timeutil.h>
#include <zephyr/settings/settings.h>
#include <zephyr/logging/log.h>
#include <nrf_modem_at.h>
#include <nrf_modem_gnss.h>

#include "assistance.h"
#include "factory_almanac.h"
#include "mcc_location_table.h"

LOG_MODULE_DECLARE(gnss_sample, 3);

/* (6.1.1980 UTC - 1.1.1970 UTC) */
#define GPS_TO_UNIX_UTC_OFFSET_SECONDS	(315964800UL)
/* UTC/GPS time offset as of 1st of January 2017. */
#define GPS_TO_UTC_LEAP_SECONDS		(18UL)
#define SEC_PER_MIN			(60UL)
#define MIN_PER_HOUR			(60UL)
#define SEC_PER_HOUR			(MIN_PER_HOUR * SEC_PER_MIN)
#define HOURS_PER_DAY			(24UL)
#define SEC_PER_DAY			(HOURS_PER_DAY * SEC_PER_HOUR)
#define DAYS_PER_WEEK			(7UL)
#define PLMN_STR_MAX_LEN		8 /* MCC + MNC + quotes */

static char almanac_checksum[64];

static int set(const char *key, size_t len_rd, settings_read_cb read_cb, void *cb_arg)
{
	int len;
	int key_len;
	const char *next;

	if (!key) {
		return -ENOENT;
	}

	key_len = settings_name_next(key, &next);

	if (!strncmp(key, "almanac_checksum", key_len)) {
		len = read_cb(cb_arg, &almanac_checksum, sizeof(almanac_checksum));
		if (len < sizeof(almanac_checksum)) {
			LOG_ERR("Failed to read almanac checksum from settings");
		}

		return 0;
	}

	return -ENOENT;
}

static struct settings_handler assistance_settings = {
	.name = "assistance",
	.h_set = set,
};

static void factory_almanac_write(void)
{
	int err;

	/* Check if the same almanac has already been written to prevent unnecessary writes
	 * to flash memory.
	 */
	if (!strncmp(almanac_checksum, FACTORY_ALMANAC_CHECKSUM, sizeof(almanac_checksum))) {
		LOG_INF("Factory almanac has already been written, skipping writing");
		return;
	}

	err = nrf_modem_at_printf("AT%%XFILEWRITE=1,\"%s\",\"%s\"",
				  FACTORY_ALMANAC, FACTORY_ALMANAC_CHECKSUM);
	if (err != 0) {
		LOG_ERR("Failed to write factory almanac");
		return;
	}

	LOG_INF("Wrote factory almanac");

	err = settings_save_one("assistance/almanac_checksum",
				FACTORY_ALMANAC_CHECKSUM,
				sizeof(almanac_checksum));
	if (err) {
		LOG_ERR("Failed to write almanac checksum to settings, error %d", err);
	}
}

static int64_t utc_to_gps_sec(const int64_t utc_sec)
{
	return (utc_sec - GPS_TO_UNIX_UTC_OFFSET_SECONDS) + GPS_TO_UTC_LEAP_SECONDS;
}

static void gps_sec_to_day_time(int64_t gps_sec,
				uint16_t *gps_day,
				uint32_t *gps_time_of_day)
{
	*gps_day = (uint16_t)(gps_sec / SEC_PER_DAY);
	*gps_time_of_day = (uint32_t)(gps_sec % SEC_PER_DAY);
}

static void time_inject(void)
{
	int ret;
	struct tm date_time;
	int64_t utc_sec;
	int64_t gps_sec;
	struct nrf_modem_gnss_agps_data_system_time_and_sv_tow gps_time = { 0 };

	/* Read current UTC time from the modem. */
	ret = nrf_modem_at_scanf("AT+CCLK?",
		"+CCLK: \"%u/%u/%u,%u:%u:%u",
		&date_time.tm_year,
		&date_time.tm_mon,
		&date_time.tm_mday,
		&date_time.tm_hour,
		&date_time.tm_min,
		&date_time.tm_sec
	);
	if (ret != 6) {
		LOG_WRN("Couldn't read current time from modem, time assistance unavailable");
		return;
	}

	/* Convert to struct tm format. */
	date_time.tm_year = date_time.tm_year + 2000 - 1900; /* years since 1900 */
	date_time.tm_mon--; /* months since January */

	/* Convert time to seconds since Unix time epoch (1.1.1970). */
	utc_sec = timeutil_timegm64(&date_time);
	/* Convert time to seconds since GPS time epoch (6.1.1980). */
	gps_sec = utc_to_gps_sec(utc_sec);

	gps_sec_to_day_time(gps_sec, &gps_time.date_day, &gps_time.time_full_s);

	ret = nrf_modem_gnss_agps_write(&gps_time, sizeof(gps_time),
					NRF_MODEM_GNSS_AGPS_GPS_SYSTEM_CLOCK_AND_TOWS);
	if (ret != 0) {
		LOG_ERR("Failed to inject time, error %d", ret);
		return;
	}

	LOG_INF("Injected time (GPS day %u, GPS time of day %u)",
		gps_time.date_day, gps_time.time_full_s);
}

static void location_inject(void)
{
	int err;
	char plmn_str[PLMN_STR_MAX_LEN + 1];
	uint16_t mcc;
	const struct mcc_table *mcc_info;
	struct nrf_modem_gnss_agps_data_location location = { 0 };

	/* Read PLMN string from modem to get the MCC. */
	err = nrf_modem_at_scanf(
		"AT%XMONITOR",
		"%%XMONITOR: "
		"%*d"                                  /* <reg_status>: ignored */
		",%*[^,]"                              /* <full_name>: ignored */
		",%*[^,]"                              /* <short_name>: ignored */
		",%"STRINGIFY(PLMN_STR_MAX_LEN)"[^,]", /* <plmn> */
		plmn_str);
	if (err != 1) {
		LOG_WRN("Couldn't read PLMN from modem, location assistance unavailable");
		return;
	}

	/* NULL terminate MCC and read it. */
	plmn_str[4] = '\0';
	mcc = strtol(plmn_str + 1, NULL, 10);

	mcc_info = mcc_lookup(mcc);
	if (mcc_info == NULL) {
		LOG_WRN("No location found for MCC %u", mcc);
		return;
	}

	location.latitude = lat_convert(mcc_info->lat);
	location.longitude = lon_convert(mcc_info->lon);
	location.unc_semimajor = mcc_info->unc_semimajor;
	location.unc_semiminor = mcc_info->unc_semiminor;
	location.orientation_major = mcc_info->orientation;
	location.confidence = mcc_info->confidence;

#if defined(CONFIG_GNSS_SAMPLE_LOW_ACCURACY)
	if (CONFIG_GNSS_SAMPLE_ASSISTANCE_REFERENCE_ALT != -32767) {
		/* Use reference altitude to enable 3-sat first fix. */
		LOG_INF("Using reference altitude %d meters",
			CONFIG_GNSS_SAMPLE_ASSISTANCE_REFERENCE_ALT);
		location.altitude = CONFIG_GNSS_SAMPLE_ASSISTANCE_REFERENCE_ALT;
		/* The altitude uncertainty has to be less than 100 meters (coded number K has to
		 * be less than 48) for the altitude to be used for a 3-sat fix. GNSS increases
		 * the uncertainty depending on the age of the altitude and whether the device is
		 * stationary or moving. The uncertainty is set to 0 (meaning 0 meters), so that
		 * it remains usable for a 3-sat fix for as long as possible.
		 */
		location.unc_altitude = 0;
	} else
#endif
	{
		location.unc_altitude = 255; /* altitude not used */
	}

	err = nrf_modem_gnss_agps_write(&location, sizeof(location), NRF_MODEM_GNSS_AGPS_LOCATION);
	if (err) {
		LOG_ERR("Failed to inject location for MCC %u, error %d", mcc, err);
		return;
	}

	LOG_INF("Injected location lat-long: [%.6f-%.6f] for MCC %u", mcc_info->lat, mcc_info->lon, mcc);
}

int assistance_init(struct k_work_q *assistance_work_q)
{
	ARG_UNUSED(assistance_work_q);

	int err;

	err = settings_subsys_init();
	if (err) {
		LOG_ERR("Settings subsystem initialization failed, error %d", err);
		return err;
	}

	err = settings_register(&assistance_settings);
	if (err) {
		LOG_ERR("Registering settings handler failed, error %d", err);
		return err;
	}

	err = settings_load();
	if (err) {
		LOG_ERR("Loading settings failed, error %d", err);
		return err;
	}

	factory_almanac_write();

	return 0;
}

int assistance_request(struct nrf_modem_gnss_agps_data_frame *agps_request)
{
	if (agps_request->data_flags & NRF_MODEM_GNSS_AGPS_SYS_TIME_AND_SV_TOW_REQUEST) {
		time_inject();
	}

	if (agps_request->data_flags & NRF_MODEM_GNSS_AGPS_POSITION_REQUEST) {
		location_inject();
	}

	return 0;
}

bool assistance_is_active(void)
{
	/* Always return false because assistance_request() doesn't take much time. */
	return false;
}
```

## src/commit_hash.h
```c
#ifndef _COMMIT_HASH_
#define _COMMIT_HASH_
#define HASH "LTE + GNSS Demo"
#endif
```

## src/gnss_app.c
```c
#include <stdio.h>
#include <stdlib.h>
#include <string.h>
#include <math.h>
#include <zephyr/kernel.h>
#include <zephyr/logging/log.h>
#include <nrf_modem_at.h>
#include <nrf_modem_gnss.h>
#include <modem/lte_lc.h>
#include <date_time.h>
#include "assistance.h"

#define FAKE_GNSS_DATA 0
#define WIP 1

LOG_MODULE_REGISTER(gnss_sample, 3);

static const char update_indicator[] = {'\\', '|', '/', '-'};

/* Opeational data */
static struct nrf_modem_gnss_pvt_data_frame last_pvt;
static uint64_t fix_timestamp;

volatile double last_latitude = 0;
volatile double last_longtitude = 0;

/* Asynchronous object to handle GNSS event */
K_MSGQ_DEFINE(nmea_queue, sizeof(struct nrf_modem_gnss_nmea_data_frame *), 10, 4);
static K_SEM_DEFINE(pvt_data_sem, 0, 1);
static K_SEM_DEFINE(time_sem, 0, 1);

static struct k_poll_event events[2] = {
    K_POLL_EVENT_STATIC_INITIALIZER(K_POLL_TYPE_SEM_AVAILABLE,
                    K_POLL_MODE_NOTIFY_ONLY,
                    &pvt_data_sem, 0),
    K_POLL_EVENT_STATIC_INITIALIZER(K_POLL_TYPE_MSGQ_DATA_AVAILABLE,
                    K_POLL_MODE_NOTIFY_ONLY,
                    &nmea_queue, 0),
};

extern void lte_connect(void);
extern void lte_disconnect(void);

/* GNSS Assitance work queue */
static struct k_work_q gnss_work_q;
#define GNSS_WORKQ_THREAD_STACK_SIZE 2304
#define GNSS_WORKQ_THREAD_PRIORITY   5
K_THREAD_STACK_DEFINE(gnss_workq_stack_area, GNSS_WORKQ_THREAD_STACK_SIZE);
static struct k_work agps_data_get_work;
static volatile bool requesting_assistance;
static struct nrf_modem_gnss_agps_data_frame last_agps;

static void agps_data_get_work_fn(struct k_work *item)
{
    ARG_UNUSED(item);

    int err;

    /* With minimal assistance, the request should be ignored if no GPS time or position
     * is requested.
     */
    if (!(last_agps.data_flags & NRF_MODEM_GNSS_AGPS_SYS_TIME_AND_SV_TOW_REQUEST) &&
        !(last_agps.data_flags & NRF_MODEM_GNSS_AGPS_POSITION_REQUEST)) {
        LOG_INF("Ignoring assistance request because no GPS time or position is requested");
        return;
    }

    requesting_assistance = true;

    LOG_INF("Assistance data needed, ephe 0x%08x, alm 0x%08x, flags 0x%02x",
        last_agps.sv_mask_ephe,
        last_agps.sv_mask_alm,
        last_agps.data_flags);

    lte_connect();
    err = assistance_request(&last_agps);
    if (err) {
        LOG_ERR("Failed to request assistance data");
    }
    lte_disconnect();

    requesting_assistance = false;
}

static int sample_init(void)
{
    int err = 0;

    struct k_work_queue_config cfg = {
        .name = "gnss_work_q",
        .no_yield = false
    };

    k_work_queue_start(
        &gnss_work_q,
        gnss_workq_stack_area,
        K_THREAD_STACK_SIZEOF(gnss_workq_stack_area),
        GNSS_WORKQ_THREAD_PRIORITY,
        &cfg);

    k_work_init(&agps_data_get_work, agps_data_get_work_fn);

    err = assistance_init(&gnss_work_q);

    return err;
}

static void gnss_event_handler(int event)
{
    int retval;
    struct nrf_modem_gnss_nmea_data_frame *nmea_data;

    switch (event) {
    case NRF_MODEM_GNSS_EVT_PVT:
        retval = nrf_modem_gnss_read(&last_pvt, sizeof(last_pvt), NRF_MODEM_GNSS_DATA_PVT);
        if (retval == 0) {
            k_sem_give(&pvt_data_sem);
        }
        break;

    case NRF_MODEM_GNSS_EVT_NMEA:
        nmea_data = k_malloc(sizeof(struct nrf_modem_gnss_nmea_data_frame));
        if (nmea_data == NULL) {
            LOG_ERR("Failed to allocate memory for NMEA");
            break;
        }

        retval = nrf_modem_gnss_read(nmea_data,
                         sizeof(struct nrf_modem_gnss_nmea_data_frame),
                         NRF_MODEM_GNSS_DATA_NMEA);
        if (retval == 0) {
            retval = k_msgq_put(&nmea_queue, &nmea_data, K_NO_WAIT);
        }

        if (retval != 0) {
            k_free(nmea_data);
        }
        break;

    case NRF_MODEM_GNSS_EVT_AGPS_REQ:
        retval = nrf_modem_gnss_read(&last_agps,
                         sizeof(last_agps),
                         NRF_MODEM_GNSS_DATA_AGPS_REQ);
        if (retval == 0) {
            k_work_submit_to_queue(&gnss_work_q, &agps_data_get_work);
        }
        break;

    default:
        break;
    }
}

static int gnss_init_and_start(void)
{
    /* Enable GNSS. */
    if (lte_lc_func_mode_set(LTE_LC_FUNC_MODE_ACTIVATE_GNSS) != 0) {
        LOG_ERR("Failed to activate GNSS functional mode");
        return -1;
    }

    /* Configure GNSS. */
    if (nrf_modem_gnss_event_handler_set(gnss_event_handler) != 0) {
        LOG_ERR("Failed to set GNSS event handler");
        return -1;
    }

    /* This use case flag should always be set. */
    uint8_t use_case = NRF_MODEM_GNSS_USE_CASE_MULTIPLE_HOT_START;
    use_case |= NRF_MODEM_GNSS_USE_CASE_SCHED_DOWNLOAD_DISABLE;
    use_case |= NRF_MODEM_GNSS_USE_CASE_LOW_ACCURACY;

    if (nrf_modem_gnss_use_case_set(use_case) != 0) {
        LOG_WRN("Failed to set GNSS use case");
    }

#if defined(CONFIG_NRF_CLOUD_AGPS_ELEVATION_MASK)
    if (nrf_modem_gnss_elevation_threshold_set(CONFIG_NRF_CLOUD_AGPS_ELEVATION_MASK) != 0) {
        LOG_ERR("Failed to set elevation threshold");
        return -1;
    }
    LOG_DBG("Set elevation threshold to %u", CONFIG_NRF_CLOUD_AGPS_ELEVATION_MASK);
#endif

    /* Default to no power saving. */
    uint8_t power_mode = NRF_MODEM_GNSS_PSM_DISABLED;

    if (nrf_modem_gnss_power_mode_set(power_mode) != 0) {
        LOG_ERR("Failed to set GNSS power saving mode");
        return -1;
    }

    /* Setting GNSS to get data at fix_retry timeout and fix_interval interval*/
    uint16_t fix_retry = 120;
    uint16_t fix_interval = 120;

    if (nrf_modem_gnss_fix_retry_set(fix_retry) != 0) {
        LOG_ERR("Failed to set GNSS fix retry");
        return -1;
    }

    if (nrf_modem_gnss_fix_interval_set(fix_interval) != 0) {
        LOG_ERR("Failed to set GNSS fix interval");
        return -1;
    }

    if (nrf_modem_gnss_start() != 0) {
        LOG_ERR("Failed to start GNSS");
        return -1;
    }

    /* Priotize GNSS to fix NRF_MODEM_GNSS_PVT_FLAG_NOT_ENOUGH_WINDOW_TIME */
    if (nrf_modem_gnss_prio_mode_enable() != 0)
    {
        LOG_ERR("Failed to prioritize GNSS over LTE");
    }

    return 0;
}

static void date_time_evt_handler(const struct date_time_evt *evt)
{
    k_sem_give(&time_sem);
}

static bool output_paused(void)
{
    return (requesting_assistance || assistance_is_active()) ? true : false;
}

static void print_satellite_stats(struct nrf_modem_gnss_pvt_data_frame *pvt_data)
{
	uint8_t tracked   = 0;
	uint8_t in_fix    = 0;
	uint8_t unhealthy = 0;

	for (int i = 0; i < NRF_MODEM_GNSS_MAX_SATELLITES; ++i) {
		if (pvt_data->sv[i].sv > 0) {
			tracked++;

			if (pvt_data->sv[i].flags & NRF_MODEM_GNSS_SV_FLAG_USED_IN_FIX) {
				in_fix++;
			}

			if (pvt_data->sv[i].flags & NRF_MODEM_GNSS_SV_FLAG_UNHEALTHY) {
				unhealthy++;
			}
		}
	}

	LOG_INF("\tTracking: %2d Using: %2d Unhealthy: %d", tracked, in_fix, unhealthy);
}

void entrypoint_gnss(void *arg1, void *arg2, void *arg3)
{
    uint8_t cnt = 0;
    struct nrf_modem_gnss_nmea_data_frame *nmea_data;

    if (sample_init() != 0) {
        LOG_ERR("Failed to initialize sample");
        return -1;
    }

    if (gnss_init_and_start() != 0) {
        LOG_ERR("Failed to initialize and start GNSS");
        return -1;
    }

    fix_timestamp = k_uptime_get();
    
    unsigned insuffcient_time_window_cnt = 0;
    bool gnss_prioritized = false;

    while (1) {
        (void)k_poll(events, 2, K_FOREVER);
        // LOG_INF("GNSS Event");

        if (events[0].state == K_POLL_STATE_SEM_AVAILABLE && k_sem_take(events[0].sem, K_NO_WAIT) == 0) {
            // LOG_INF("\tevents[0] last_pvt.flags: %02x", last_pvt.flags);
            // print_satellite_stats(&last_pvt);
            if (last_pvt.flags & NRF_MODEM_GNSS_PVT_FLAG_DEADLINE_MISSED) {
            }
            if (last_pvt.flags & NRF_MODEM_GNSS_PVT_FLAG_NOT_ENOUGH_WINDOW_TIME) {
                insuffcient_time_window_cnt++;
                if(insuffcient_time_window_cnt >= 3)
                {
                    if (gnss_prioritized == false)
                    {
                        /* Priotize GNSS to fix NRF_MODEM_GNSS_PVT_FLAG_NOT_ENOUGH_WINDOW_TIME */
                        if (nrf_modem_gnss_prio_mode_enable() != 0)
                        {
                            LOG_ERR("Failed to prioritize GNSS over LTE");
                        }
                        LOG_INF("Insufficient GNSS time windows, priortizing GNSS over LTE");
                        gnss_prioritized = true;
                    }
                }
            }

            if (last_pvt.flags & NRF_MODEM_GNSS_PVT_FLAG_SLEEP_BETWEEN_PVT) {
            }

            if (last_pvt.flags & NRF_MODEM_GNSS_PVT_FLAG_FIX_VALID) {
                LOG_INF("GNSS get a valid fix [%f][%f] after %d", last_pvt.latitude, last_pvt.longitude, (k_uptime_get() - fix_timestamp) / 1000);
                fix_timestamp = k_uptime_get();
                insuffcient_time_window_cnt = 0;
                gnss_prioritized = false;
                last_latitude = last_pvt.latitude;
                last_longtitude = last_pvt.longitude;
            } 
        }

        if (events[1].state == K_POLL_STATE_MSGQ_DATA_AVAILABLE && k_msgq_get(events[1].msgq, &nmea_data, K_NO_WAIT) == 0) {
            // LOG_INF("\tevents[1]", last_pvt.flags);
            /* New NMEA data available */
            k_free(nmea_data);
        }

        events[0].state = K_POLL_STATE_NOT_READY;
        events[1].state = K_POLL_STATE_NOT_READY; 
    }

    return 0;
}
```
